## src/main/Kconfig.projbuild
```kconfig
menu "WiFi Configuration"

config WIFI_SSID
	string "WiFi SSID"
	default ""

config WIFI_PASSWORD
	string "WiFi Password"
	default ""

endmenu

menu "I2C Configuration"

config I2C_SDA_PIN
	int "I2C SDA Pin"
	default 6
config I2C_SCL_PIN
	int "I2C SCL Pin"
	default 7
config I2C_ADDRESS
	hex "I2C Address"
	default 0x3C

endmenu

menu "Weather Location"

config WEATHER_LOCATION
	string "Weather Location"
	default ""

endmenu
```
